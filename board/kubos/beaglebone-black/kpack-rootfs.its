## board/kubos/beaglebone-black/kpack-rootfs.its
```
/*
 * RadSat rootfs/kernel/dtb-only upgrade package (no U-Boot).
 * Use for Phase 1 deploy while keeping the live Oct-29 (pre-MRAM) bootloader.
 */

/dts-v1/;

/ {
	description = "RadSat rootfs+kernel+dtb upgrade for BBB (no U-Boot)";
	#address-cells = <1>;

	images {
		kernel@1 {
			data = /incbin/("./kernel");
			type = "firmware";
			arch = "arm";
			os = "linux";
			compression = "none";
			load = <00000000>;
			entry = <00000000>;
			hash@1 {
				algo = "sha256";
			};
		};
		rootfs@1 {
			data = /incbin/("./rootfs.ext2");
			type = "firmware";
			arch = "arm";
			os = "linux";
			compression = "none";
			load = <00000000>;
			entry = <00000000>;
			hash@1 {
				algo = "sha256";
			};
		};
		beaglebone-black.dtb@1 {
			data = /incbin/("./beaglebone-black.dtb");
			type = "firmware";
			arch = "arm";
			os = "linux";
			compression = "none";
			load = <00000000>;
			entry = <00000000>;
			hash@1 {
				algo = "sha256";
			};
		};
	};
};
```

## board/kubos/beaglebone-black/kpack-uboot.its
```
/*
 * Kubos / RadSat U-Boot-only upgrade package (dual FAT copies).
 * FIT node names uboot / uboot-bak map to u-boot.img / u-boot-bak.img via
 * update_kubos name mapping.
 */

/dts-v1/;

/ {
	description = "RadSat dual U-Boot upgrade for BBB";
	#address-cells = <1>;

	images {
		uboot@1 {
			description = "Primary U-Boot (u-boot.img)";
			data = /incbin/("./u-boot.img");
			type = "firmware";
			arch = "arm";
			os = "linux";
			compression = "none";
			load = <00000000>;
			entry = <00000000>;
			hash@1 {
				algo = "sha256";
			};
		};
		uboot-bak@1 {
			description = "Backup U-Boot (u-boot-bak.img)";
			data = /incbin/("./u-boot.img");
			type = "firmware";
			arch = "arm";
			os = "linux";
			compression = "none";
			load = <00000000>;
			entry = <00000000>;
			hash@1 {
				algo = "sha256";
			};
		};
	};
};
```

## package/kubos/kubos-comms-cli/Config.in
```kconfig
menuconfig BR2_PACKAGE_KUBOS_COMMS_CLI
    bool "RADSAT Comms CLI"
    default n
    select BR2_PACKAGE_HAS_KUBOS_COMMS_CLI
    help
        Include the RADSAT comms-cli operator tool. A typed command-line
        client for the comms-services GraphQL API (defaults to
        http://127.0.0.1:8150/graphql, override with --url). Installed to
        /usr/bin; it is not a daemon so no init script or monit entry is
        created.

config BR2_PACKAGE_HAS_KUBOS_COMMS_CLI
    bool

config BR2_PACKAGE_PROVIDES_KUBOS_COMMS_CLI
    string
    default "kubos"
```

## package/kubos/kubos-comms/Config.in
```kconfig
menuconfig BR2_PACKAGE_KUBOS_COMMS
    bool "RADSAT NXTRX4 Communications Service"
    default n
    select BR2_PACKAGE_HAS_KUBOS_COMMS
    help
        Include RADSAT NXTRX4 Communications Service as a Kubos service.

if BR2_PACKAGE_KUBOS_COMMS

config BR2_KUBOS_COMMS_INIT_LVL
    int "Service Run Level"
    default 95
    range 10 99
    depends on BR2_PACKAGE_KUBOS_COMMS
    help
        The initialization priority level of the RADSAT NXTRX4 Communications Service.
        The lower the number, the earlier the service is initialized.

config BR2_KUBOS_COMMS_RESTART_COUNT
    int "Service Restart Limit"
    default 3
    depends on BR2_PACKAGE_KUBOS_COMMS
    depends on BR2_PACKAGE_MONIT
    help
        The maximum number of times the service should be restarted within the timeframe
        specified by BR2_KUBOS_COMMS_RESTART_CYCLES if it goes down

config BR2_KUBOS_COMMS_RESTART_CYCLES
    int "Service Restart Limit Timeframe"
    default 10
    depends on BR2_PACKAGE_KUBOS_COMMS
    depends on BR2_PACKAGE_MONIT
    help
        The number of Monit monitoring cycles in which the maximum number of service restarts
        must occur before the system stops trying to recover the service.

        The resulting maximum timeframe in which the restarts must occur can be calculated by
        multiplying this number by the length of a single Monit sleep cycle (60 seconds)

config BR2_KUBOS_COMMS_PORT
    int "Service Port"
    default 8150
    depends on BR2_PACKAGE_KUBOS_COMMS
    help
        The port which the service should use to receive GraphQL requests

endif

config BR2_PACKAGE_HAS_KUBOS_COMMS
    bool

config BR2_PACKAGE_PROVIDES_KUBOS_COMMS
    string
    default "kubos"
```

## package/kubos/kubos-cube-adcs/Config.in
```kconfig
menuconfig BR2_PACKAGE_KUBOS_CUBE_ADCS
    bool "RADSAT Cube ADCS Service"
    default n
    select BR2_PACKAGE_HAS_KUBOS_CUBE_ADCS
    help
        Include RADSAT Cube ADCS Service as a Kubos service.

if BR2_PACKAGE_KUBOS_CUBE_ADCS

config BR2_KUBOS_CUBE_ADCS_INIT_LVL
    int "Service Run Level"
    default 90
    range 10 99
    depends on BR2_PACKAGE_KUBOS_CUBE_ADCS
    help
        The initialization priority level of the RADSAT Cube ADCS Service.
        The lower the number, the earlier the service is initialized.

config BR2_KUBOS_CUBE_ADCS_RESTART_COUNT
    int "Service Restart Limit"
    default 3
    depends on BR2_PACKAGE_KUBOS_CUBE_ADCS
    depends on BR2_PACKAGE_MONIT
    help
        The maximum number of times the service should be restarted within the timeframe
        specified by BR2_KUBOS_CUBE_ADCS_RESTART_CYCLES if it goes down

config BR2_KUBOS_CUBE_ADCS_RESTART_CYCLES
    int "Service Restart Limit Timeframe"
    default 10
    depends on BR2_PACKAGE_KUBOS_CUBE_ADCS
    depends on BR2_PACKAGE_MONIT
    help
        The number of Monit monitoring cycles in which the maximum number of service restarts
        must occur before the system stops trying to recover the service.

        The resulting maximum timeframe in which the restarts must occur can be calculated by
        multiplying this number by the length of a single Monit sleep cycle (60 seconds)

config BR2_KUBOS_CUBE_ADCS_IP
    string "Service IP Address"
    default "0.0.0.0"
    depends on BR2_PACKAGE_KUBOS_CUBE_ADCS
    help
        The IP address which the service should use to receive GraphQL requests

config BR2_KUBOS_CUBE_ADCS_PORT
    int "Service Port"
    default 8094
    depends on BR2_PACKAGE_KUBOS_CUBE_ADCS
    help
        The port which the service should use to receive GraphQL requests

config BR2_KUBOS_CUBE_ADCS_CAN_INTERFACE
    string "CAN Interface"
    default "can0"
    depends on BR2_PACKAGE_KUBOS_CUBE_ADCS
    help
        Linux SocketCAN interface connected to the CubeSpace ADCS.

config BR2_KUBOS_CUBE_ADCS_CAN_BITRATE
    int "CAN Bitrate"
    default 1000000
    depends on BR2_PACKAGE_KUBOS_CUBE_ADCS
    help
        CAN bus bitrate.

config BR2_KUBOS_CUBE_ADCS_SOURCE_ADDRESS
    int "Source Address"
    default 1
    depends on BR2_PACKAGE_KUBOS_CUBE_ADCS
    help
        CubeSpace source address used by the OBC.

config BR2_KUBOS_CUBE_ADCS_DESTINATION_ADDRESS
    int "Destination Address"
    default 4
    depends on BR2_PACKAGE_KUBOS_CUBE_ADCS
    help
        CubeSpace destination address used by the ADCS.

config BR2_KUBOS_CUBE_ADCS_TIMEOUT_MS
    int "Timeout Milliseconds"
    default 5000
    depends on BR2_PACKAGE_KUBOS_CUBE_ADCS
    help
        Request/response timeout in milliseconds.

endif

config BR2_PACKAGE_HAS_KUBOS_CUBE_ADCS
    bool

config BR2_PACKAGE_PROVIDES_KUBOS_CUBE_ADCS
    string
    default "kubos"
```

## package/kubos/kubos-dosimeter/Config.in
```kconfig
menuconfig BR2_PACKAGE_KUBOS_DOSIMETER
    bool "RADSAT Dosimeter Service"
    default n
    select BR2_PACKAGE_HAS_KUBOS_DOSIMETER
    help
        Include RADSAT Dosimeter Service as a Kubos service.

if BR2_PACKAGE_KUBOS_DOSIMETER

config BR2_KUBOS_DOSIMETER_INIT_LVL
    int "Service Run Level"
    default 90
    range 10 99
    depends on BR2_PACKAGE_KUBOS_DOSIMETER
    help
        The initialization priority level of the RADSAT Dosimeter Service.
        The lower the number, the earlier the service is initialized.

config BR2_KUBOS_DOSIMETER_RESTART_COUNT
    int "Service Restart Limit"
    default 3
    depends on BR2_PACKAGE_KUBOS_DOSIMETER
    depends on BR2_PACKAGE_MONIT
    help
        The maximum number of times the service should be restarted within the timeframe
        specified by BR2_KUBOS_DOSIMETER_RESTART_CYCLES if it goes down

config BR2_KUBOS_DOSIMETER_RESTART_CYCLES
    int "Service Restart Limit Timeframe"
    default 10
    depends on BR2_PACKAGE_KUBOS_DOSIMETER
    depends on BR2_PACKAGE_MONIT
    help
        The number of Monit monitoring cycles in which the maximum number of service restarts
        must occur before the system stops trying to recover the service.

        The resulting maximum timeframe in which the restarts must occur can be calculated by
        multiplying this number by the length of a single Monit sleep cycle (60 seconds)

config BR2_KUBOS_DOSIMETER_IP
    string "Service IP Address"
    default "0.0.0.0"
    depends on BR2_PACKAGE_KUBOS_DOSIMETER
    help
        The IP address which the service should use to receive GraphQL requests

config BR2_KUBOS_DOSIMETER_PORT
    int "Service Port"
    default 8093
    depends on BR2_PACKAGE_KUBOS_DOSIMETER
    help
        The port which the service should use to receive GraphQL requests

config BR2_KUBOS_DOSIMETER_I2C_BUS
    string "I2C Bus"
    default "/dev/i2c-1"
    depends on BR2_PACKAGE_KUBOS_DOSIMETER
    help
        Linux I2C bus connected to the dosimeter.

config BR2_KUBOS_DOSIMETER_DEVICE_ADDR
    hex "Device I2C Address"
    default 0x48
    depends on BR2_PACKAGE_KUBOS_DOSIMETER
    help
        Linux 7-bit I2C address for the dosimeter.

endif

config BR2_PACKAGE_HAS_KUBOS_DOSIMETER
    bool

config BR2_PACKAGE_PROVIDES_KUBOS_DOSIMETER
    string
    default "kubos"
```

## package/kubos/kubos-fram/Config.in
```kconfig
menuconfig BR2_PACKAGE_KUBOS_FRAM
    bool "RADSAT FRAM Service"
    default n
    select BR2_PACKAGE_HAS_KUBOS_FRAM
    help
        Include RADSAT FRAM Service as a Kubos service.

if BR2_PACKAGE_KUBOS_FRAM

config BR2_KUBOS_FRAM_INIT_LVL
    int "Service Run Level"
    default 90
    range 10 99
    depends on BR2_PACKAGE_KUBOS_FRAM
    help
        The initialization priority level of the RADSAT FRAM Service.
        The lower the number, the earlier the service is initialized.

config BR2_KUBOS_FRAM_RESTART_COUNT
    int "Service Restart Limit"
    default 3
    depends on BR2_PACKAGE_KUBOS_FRAM
    depends on BR2_PACKAGE_MONIT
    help
        The maximum number of times the service should be restarted within the timeframe
        specified by BR2_KUBOS_FRAM_RESTART_CYCLES if it goes down

config BR2_KUBOS_FRAM_RESTART_CYCLES
    int "Service Restart Limit Timeframe"
    default 10
    depends on BR2_PACKAGE_KUBOS_FRAM
    depends on BR2_PACKAGE_MONIT
    help
        The number of Monit monitoring cycles in which the maximum number of service restarts
        must occur before the system stops trying to recover the service.

        The resulting maximum timeframe in which the restarts must occur can be calculated by
        multiplying this number by the length of a single Monit sleep cycle (60 seconds)

config BR2_KUBOS_FRAM_IP
    string "Service IP Address"
    default "0.0.0.0"
    depends on BR2_PACKAGE_KUBOS_FRAM
    help
        The IP address which the service should use to receive GraphQL requests

config BR2_KUBOS_FRAM_PORT
    int "Service Port"
    default 8091
    depends on BR2_PACKAGE_KUBOS_FRAM
    help
        The port which the service should use to receive GraphQL requests

config BR2_KUBOS_FRAM_I2C_BUS
    string "I2C Bus"
    default "/dev/i2c-2"
    depends on BR2_PACKAGE_KUBOS_FRAM
    help
        Linux I2C bus connected to the FRAM.

config BR2_KUBOS_FRAM_I2C_ADDR
    string "I2C Address"
    default "0x50"
    depends on BR2_PACKAGE_KUBOS_FRAM
    help
        Linux 7-bit I2C address for the FRAM, formatted as a hex string.

config BR2_KUBOS_FRAM_CAPACITY_BYTES
    int "Capacity Bytes"
    default 8192
    depends on BR2_PACKAGE_KUBOS_FRAM
    help
        FRAM capacity in bytes.

config BR2_KUBOS_FRAM_ADDRESS_WIDTH_BYTES
    int "Address Width Bytes"
    default 2
    depends on BR2_PACKAGE_KUBOS_FRAM
    help
        Number of memory address bytes used by the FRAM.

config BR2_KUBOS_FRAM_MAX_TRANSFER_BYTES
    int "Max Transfer Bytes"
    default 32
    depends on BR2_PACKAGE_KUBOS_FRAM
    help
        Maximum I2C payload bytes per transfer.

config BR2_KUBOS_FRAM_FW_PRINTENV
    string "fw_printenv Path"
    default "/usr/sbin/fw_printenv"
    depends on BR2_PACKAGE_KUBOS_FRAM
    help
        Path to the U-Boot fw_printenv utility.

config BR2_KUBOS_FRAM_FW_SETENV
    string "fw_setenv Path"
    default "/usr/sbin/fw_setenv"
    depends on BR2_PACKAGE_KUBOS_FRAM
    help
        Path to the U-Boot fw_setenv utility.

endif

config BR2_PACKAGE_HAS_KUBOS_FRAM
    bool

config BR2_PACKAGE_PROVIDES_KUBOS_FRAM
    string
    default "kubos"
```

## package/kubos/kubos-hal-i2c/Config.in
```kconfig
config BR2_PACKAGE_KUBOS_HAL_I2C
	bool "Python I2C HAL"
	default y
	depends on BR2_PACKAGE_PYTHON3
	select BR2_PACKAGE_PYTHON_REQUESTS
	select BR2_PACKAGE_PYTHON_TOML
	help
	  Include the Kubos I2C HAL for Python.
```

## package/kubos/kubos-mram/Config.in
```kconfig
menuconfig BR2_PACKAGE_KUBOS_MRAM
    bool "RADSAT MRAM Service"
    default n
    select BR2_PACKAGE_HAS_KUBOS_MRAM
    help
        Include RADSAT MRAM Service as a Kubos service.

if BR2_PACKAGE_KUBOS_MRAM

config BR2_KUBOS_MRAM_INIT_LVL
    int "Service Run Level"
    default 90
    range 10 99
    depends on BR2_PACKAGE_KUBOS_MRAM
    help
        The initialization priority level of the RADSAT MRAM Service.
        The lower the number, the earlier the service is initialized.

config BR2_KUBOS_MRAM_RESTART_COUNT
    int "Service Restart Limit"
    default 3
    depends on BR2_PACKAGE_KUBOS_MRAM
    depends on BR2_PACKAGE_MONIT
    help
        The maximum number of times the service should be restarted within the timeframe
        specified by BR2_KUBOS_MRAM_RESTART_CYCLES if it goes down

config BR2_KUBOS_MRAM_RESTART_CYCLES
    int "Service Restart Limit Timeframe"
    default 10
    depends on BR2_PACKAGE_KUBOS_MRAM
    depends on BR2_PACKAGE_MONIT
    help
        The number of Monit monitoring cycles in which the maximum number of service restarts
        must occur before the system stops trying to recover the service.

        The resulting maximum timeframe in which the restarts must occur can be calculated by
        multiplying this number by the length of a single Monit sleep cycle (60 seconds)

config BR2_KUBOS_MRAM_IP
    string "Service IP Address"
    default "0.0.0.0"
    depends on BR2_PACKAGE_KUBOS_MRAM
    help
        The IP address which the service should use to receive GraphQL requests

config BR2_KUBOS_MRAM_PORT
    int "Service Port"
    default 8090
    depends on BR2_PACKAGE_KUBOS_MRAM
    help
        The port which the service should use to receive GraphQL requests

config BR2_KUBOS_MRAM_SPI_DEVICE
    string "SPI Device"
    default "/dev/spidev1.0"
    depends on BR2_PACKAGE_KUBOS_MRAM
    help
        Linux spidev device connected to the MRAM.

config BR2_KUBOS_MRAM_SPI_SPEED_HZ
    int "SPI Speed (Hz)"
    default 10000000
    depends on BR2_PACKAGE_KUBOS_MRAM
    help
        SPI clock speed for the MRAM device.

config BR2_KUBOS_MRAM_SPI_MODE
    int "SPI Mode"
    default 0
    depends on BR2_PACKAGE_KUBOS_MRAM
    help
        SPI mode for the MRAM device.

endif

config BR2_PACKAGE_HAS_KUBOS_MRAM
    bool

config BR2_PACKAGE_PROVIDES_KUBOS_MRAM
    string
    default "kubos"
```

## package/kubos/kubos-service-lib/Config.in
```kconfig
config BR2_PACKAGE_KUBOS_SERVICE_LIB
	bool "Kubos Service Python Library"
	depends on BR2_PACKAGE_PYTHON3
	select BR2_PACKAGE_PYTHON_FLASK
	select BR2_PACKAGE_PYTHON_GRAPHENE
	select BR2_PACKAGE_PYTHON_GRAPHQL_SERVER
	select BR2_PACKAGE_PYTHON_TOML
	help
	  Include the Kubos service library for Python.

	  This library simplifies writing services. Include it when
	  using services written in Python.
```
