## package/kubos/kubos-snn/Config.in
```kconfig
menuconfig BR2_PACKAGE_KUBOS_SNN
    bool "RADSAT SNN Service"
    default n
    select BR2_PACKAGE_HAS_KUBOS_SNN
    help
        Include RADSAT SNN Service as a Kubos service.

if BR2_PACKAGE_KUBOS_SNN

config BR2_KUBOS_SNN_INIT_LVL
    int "Service Run Level"
    default 90
    range 10 99
    depends on BR2_PACKAGE_KUBOS_SNN
    help
        The initialization priority level of the RADSAT SNN Service.
        The lower the number, the earlier the service is initialized.

config BR2_KUBOS_SNN_RESTART_COUNT
    int "Service Restart Limit"
    default 3
    depends on BR2_PACKAGE_KUBOS_SNN
    depends on BR2_PACKAGE_MONIT
    help
        The maximum number of times the service should be restarted within the timeframe
        specified by BR2_KUBOS_SNN_RESTART_CYCLES if it goes down

config BR2_KUBOS_SNN_RESTART_CYCLES
    int "Service Restart Limit Timeframe"
    default 10
    depends on BR2_PACKAGE_KUBOS_SNN
    depends on BR2_PACKAGE_MONIT
    help
        The number of Monit monitoring cycles in which the maximum number of service restarts
        must occur before the system stops trying to recover the service.

        The resulting maximum timeframe in which the restarts must occur can be calculated by
        multiplying this number by the length of a single Monit sleep cycle (60 seconds)

config BR2_KUBOS_SNN_IP
    string "Service IP Address"
    default "0.0.0.0"
    depends on BR2_PACKAGE_KUBOS_SNN
    help
        The IP address which the service should use to receive GraphQL requests

config BR2_KUBOS_SNN_PORT
    int "Service Port"
    default 8092
    depends on BR2_PACKAGE_KUBOS_SNN
    help
        The port which the service should use to receive GraphQL requests

config BR2_KUBOS_SNN_UART_BUS
    string "UART Bus"
    default "/dev/ttyS4"
    depends on BR2_PACKAGE_KUBOS_SNN
    help
        Linux UART connected to the SNN payload board. Wiring is TBD.

endif

config BR2_PACKAGE_HAS_KUBOS_SNN
    bool

config BR2_PACKAGE_PROVIDES_KUBOS_SNN
    string
    default "kubos"
```

## package/kubos/kubos-star-risc/Config.in
```kconfig
menuconfig BR2_PACKAGE_KUBOS_STAR_RISC
    bool "RADSAT Star RISC Service"
    default n
    select BR2_PACKAGE_HAS_KUBOS_STAR_RISC
    help
        Include RADSAT Star RISC Service as a Kubos service.

if BR2_PACKAGE_KUBOS_STAR_RISC

config BR2_KUBOS_STAR_RISC_INIT_LVL
    int "Service Run Level"
    default 90
    range 10 99
    depends on BR2_PACKAGE_KUBOS_STAR_RISC
    help
        The initialization priority level of the RADSAT Star RISC Service.
        The lower the number, the earlier the service is initialized.

config BR2_KUBOS_STAR_RISC_RESTART_COUNT
    int "Service Restart Limit"
    default 3
    depends on BR2_PACKAGE_KUBOS_STAR_RISC
    depends on BR2_PACKAGE_MONIT
    help
        The maximum number of times the service should be restarted within the timeframe
        specified by BR2_KUBOS_STAR_RISC_RESTART_CYCLES if it goes down

config BR2_KUBOS_STAR_RISC_RESTART_CYCLES
    int "Service Restart Limit Timeframe"
    default 10
    depends on BR2_PACKAGE_KUBOS_STAR_RISC
    depends on BR2_PACKAGE_MONIT
    help
        The number of Monit monitoring cycles in which the maximum number of service restarts
        must occur before the system stops trying to recover the service.

        The resulting maximum timeframe in which the restarts must occur can be calculated by
        multiplying this number by the length of a single Monit sleep cycle (60 seconds)

config BR2_KUBOS_STAR_RISC_IP
    string "Service IP Address"
    default "0.0.0.0"
    depends on BR2_PACKAGE_KUBOS_STAR_RISC
    help
        The IP address which the service should use to receive GraphQL requests

config BR2_KUBOS_STAR_RISC_PORT
    int "Service Port"
    default 8001
    depends on BR2_PACKAGE_KUBOS_STAR_RISC
    help
        The port which the service should use to receive GraphQL requests

config BR2_KUBOS_STAR_RISC_UART_BUS
    string "UART Bus"
    default "TBD"
    depends on BR2_PACKAGE_KUBOS_STAR_RISC
    help
        Linux UART connected to the Star RISC payload. Wiring is TBD.

config BR2_KUBOS_STAR_RISC_UART_BAUD
    int "UART Baud"
    default 115200
    depends on BR2_PACKAGE_KUBOS_STAR_RISC
    help
        UART baud rate for the Star RISC payload.

endif

config BR2_PACKAGE_HAS_KUBOS_STAR_RISC
    bool

config BR2_PACKAGE_PROVIDES_KUBOS_STAR_RISC
    string
    default "kubos"
```

## package/python/Config.in
```kconfig
menu "Additional Python Packages"
source "$BR2_EXTERNAL_KUBOS_LINUX_PATH/package/python/python-graphene/Config.in"
source "$BR2_EXTERNAL_KUBOS_LINUX_PATH/package/python/python-graphql-core/Config.in"
source "$BR2_EXTERNAL_KUBOS_LINUX_PATH/package/python/python-graphql-relay/Config.in"
source "$BR2_EXTERNAL_KUBOS_LINUX_PATH/package/python/python-graphql-server/Config.in"
endmenu
```

## package/python/python-graphene/Config.in
```kconfig
config BR2_PACKAGE_PYTHON_GRAPHENE
	bool "python-graphene"
	select BR2_PACKAGE_PYTHON_GRAPHQL_CORE # runtime
	select BR2_PACKAGE_PYTHON_GRAPHQL_RELAY # runtime
	select BR2_PACKAGE_PYTHON_DATEUTIL # runtime
	select BR2_PACKAGE_PYTHON_TYPING_EXTENSIONS # runtime
	help
	  GraphQL Framework for Python.

	  https://github.com/graphql-python/graphene
```

## package/python/python-graphql-core/Config.in
```kconfig
config BR2_PACKAGE_PYTHON_GRAPHQL_CORE
	bool "python-graphql-core"
	help
	  GraphQL implementation for Python.

	  https://github.com/graphql-python/graphql-core
```

## package/python/python-graphql-relay/Config.in
```kconfig
config BR2_PACKAGE_PYTHON_GRAPHQL_RELAY
	bool "python-graphql-relay"
	select BR2_PACKAGE_PYTHON_GRAPHQL_CORE # runtime
	help
	  Relay implementation for Python.

	  https://github.com/graphql-python/graphql-relay-py
```

## package/python/python-graphql-server/Config.in
```kconfig
config BR2_PACKAGE_PYTHON_GRAPHQL_SERVER
	bool "python-graphql-server"
	select BR2_PACKAGE_PYTHON_GRAPHQL_CORE # runtime
	help
	  GraphQL server integrations for Python web frameworks.

	  https://github.com/graphql-python/graphql-server
```

## tools/kpack-sample.its
```
/dts-v1/;

/ {
	description = "Sample Kubos upgrade (device tree only)";
	#address-cells = <1>;

	images {
		beaglebone-black.dtb@1 {
			data = /incbin/("./beaglebone-black.dtb");
			type = "firmware";
			arch = "arm";
			os = "linux";
			compression = "none";
			load = <00000000>;
			entry = <00000000>;
			hash@1 {
				algo = "sha256";
			};
		};
	};
};
```
